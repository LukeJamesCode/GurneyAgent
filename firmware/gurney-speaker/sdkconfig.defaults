## firmware/gurney-speaker/sdkconfig.defaults
```kconfig
# Default config for the gurney-speaker firmware. `idf.py set-target esp32s3`
# generates an sdkconfig from these; override per-board values via
# `idf.py menuconfig`.

CONFIG_IDF_TARGET="esp32s3"

# Flash size — Freenove ESP32-S3 ships with 8 MB of flash. partitions.csv
# allocates ~3.5 MB for the app + spiffs; 8 MB leaves room for future OTA.
CONFIG_ESPTOOLPY_FLASHSIZE_8MB=y
CONFIG_ESPTOOLPY_FLASHSIZE="8MB"

# More RAM for the audio frontend + Opus decoder.
CONFIG_SPIRAM=y
CONFIG_SPIRAM_MODE_OCT=y
CONFIG_SPIRAM_USE_MALLOC=y
CONFIG_SPIRAM_MALLOC_ALWAYSINTERNAL=16384

# FreeRTOS tick rate — 1 kHz keeps audio buffers responsive.
CONFIG_FREERTOS_HZ=1000

# Larger main task stack so the boot orchestrator doesn't overflow when LVGL
# inits.
CONFIG_ESP_MAIN_TASK_STACK_SIZE=8192

# Logging: info by default; bump to debug while bringing up new hardware.
CONFIG_LOG_DEFAULT_LEVEL_INFO=y
CONFIG_LOG_COLORS=y

# Bump task watchdog timeout — WakeNet model loads + I2S init can each take
# multiple seconds during cold boot; the default 5 s is too tight for our
# stack but the underlying tasks are fine and won't actually hang.
CONFIG_ESP_TASK_WDT_TIMEOUT_S=30

# Use the custom partition table (NVS + app + storage).
CONFIG_PARTITION_TABLE_CUSTOM=y
CONFIG_PARTITION_TABLE_CUSTOM_FILENAME="partitions.csv"

# WebSocket client component pulled from idf-extra-components.
CONFIG_WS_TRANSPORT=y

# esp-sr wake-word model selection. wn9_hiesp ("Hi, ESP") is the English
# placeholder; the model partition declared in partitions.csv is auto-flashed
# by esp-sr's build hook on `idf.py flash`. Swap to a different built-in via
# `idf.py menuconfig` → ESP Speech Recognition → Wake word model. For a
# custom "Hey Gurney" model, train via the esp-sr tools (see SETUP.md
# appendix) and load it through the menuconfig "User customized model" path.
#
# NOTE: sdkconfig.defaults is only applied when sdkconfig doesn't exist yet.
# If you're upgrading from v0.1, delete the existing sdkconfig before running
# `idf.py reconfigure` — otherwise the previous wake-word selection sticks
# and the build packs the wrong model (and a much larger srmodels.bin that
# overruns the 3 MB model partition).
CONFIG_SR_WN_WN9_HIESP=y

# We don't use MultiNet (command-word recognition) — turning it off keeps
# the model image small enough to fit the 3 MB partition. With MN on plus
# the Chinese mn6_cn default, srmodels.bin balloons past 3.8 MB.
CONFIG_USE_MULTINET=n
```
